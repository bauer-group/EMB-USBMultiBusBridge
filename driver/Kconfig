## driver/Kconfig
```kconfig
config RPBRIDGE
	tristate "RPBridge USB multi-bus bridge driver"
	depends on USB
	depends on AUXILIARY_BUS
	help
	  This driver exposes the RPBridge USB multi-bus developer tool
	  (built on the Raspberry Pi RP2354B) as a set of standard Linux
	  subsystems: I²C adapter, SPI controller, GPIO chip with IRQ
	  support, IIO ADC, PWM chip, and an auxiliary transport for the
	  userspace control tools.

	  CAN uses a separate gs_usb-compatible USB vendor interface that
	  is bound by the mainline drivers/net/can/usb/gs_usb.ko driver —
	  this module does not duplicate it.

	  Implemented in C against the stable Linux kernel API; no
	  CONFIG_RUST dependency. Builds against any kernel from 5.15
	  onwards (the auxiliary_bus baseline). Tested in CI against the
	  Linux 7.0 LTS kernel that ships with Ubuntu 26.04 LTS.

	  If unsure, say N.

	  To compile this driver as a module, choose M here: the module
	  will be called rpbridge.
```
